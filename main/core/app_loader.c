// ================ app_loader.c - JSON .app 加载 ================

#include "app_loader.h"
#include "hal/sdcard.h"
#include "esp_log.h"
#include "esp_heap_caps.h"
#include <stdio.h>
#include <string.h>
#include <stdlib.h>
#include <dirent.h>
#include <sys/stat.h>
#include <unistd.h>
#include <fcntl.h>

static const char *TAG = "app_loader";

// 极简 JSON 字段取值（不依赖 cJSON）
// 返回值: 0 ok, -1 没有
static int json_get(const char *json, size_t json_len,
                    const char *key, char *out, int out_sz)
{
    char pat[64];
    snprintf(pat, sizeof(pat), "\"%s\"", key);
    char *p = strstr(json, pat);
    if (!p) return -1;
    p = strchr(p, ':');
    if (!p) return -1;
    p++;
    while (*p == ' ' || *p == '\t' || *p == '\n' || *p == '\r') p++;
    int n = 0;
    if (*p == '"') {
        p++;
        while (*p && *p != '"' && n < out_sz - 1) {
            out[n++] = *p++;
        }
    } else {
        while (*p && *p != ',' && *p != '}' && *p != '\n' && n < out_sz - 1) {
            out[n++] = *p++;
        }
    }
    out[n] = 0;
    return 0;
}

int app_loader_load_file(const char *path, app_info_t *out)
{
    if (!out || !path) return -1;
    memset(out, 0, sizeof(*out));

    FILE *f = fopen(path, "r");
    if (!f) {
        ESP_LOGW(TAG, "open %s fail", path);
        return -1;
    }
    fseek(f, 0, SEEK_END);
    long sz = ftell(f);
    fseek(f, 0, SEEK_SET);
    if (sz <= 0 || sz > 8192) {
        fclose(f);
        return -1;
    }
    char *buf = heap_caps_malloc(sz + 1, MALLOC_CAP_SPIRAM);
    if (!buf) { fclose(f); return -1; }
    fread(buf, 1, sz, f);
    buf[sz] = 0;
    fclose(f);

    char id[32], name[32], glyph[16], version[16];
    if (json_get(buf, sz, "id", id, sizeof(id)) != 0) goto fail;
    if (json_get(buf, sz, "name", name, sizeof(name)) != 0) goto fail;
    json_get(buf, sz, "glyph", glyph, sizeof(glyph));
    json_get(buf, sz, "version", version, sizeof(version));

    out->id = strdup(id);
    out->name = strdup(name);
    out->glyph = strdup(glyph);
    out->version = strdup(version);
    out->is_system = false;
    out->is_installed = true;
    free(buf);
    ESP_LOGI(TAG, "loaded %s [%s] %s", out->id, out->name, out->version);
    return 0;
fail:
    free(buf);
    return -1;
}

int app_loader_scan_app_dir(void)
{
    if (!sdcard_is_mounted()) {
        ESP_LOGW(TAG, "SD not mounted, skip scan");
        return 0;
    }
    const char *dir = "/sdcard/roms";
    mkdir(dir, 0755);   // 不存在则创建

    DIR *d = opendir(dir);
    if (!d) return 0;
    int n = 0;
    struct dirent *de;
    while ((de = readdir(d))) {
        if (strstr(de->d_name, ".app")) {
            char path[128];
            snprintf(path, sizeof(path), "%s/%s", dir, de->d_name);
            ESP_LOGI(TAG, "found %s", path);
            n++;
        }
    }
    closedir(d);
    return n;
}

int app_loader_blocks_to_python(const char *const *blocks, int n,
                                char *buf, int buf_sz)
{
    int off = 0;
    off += snprintf(buf + off, buf_sz - off, "# Generated by xiaomiao-os\n");
    for (int i = 0; i < n && off < buf_sz - 32; i++) {
        off += snprintf(buf + off, buf_sz - off, "%s\n", blocks[i]);
    }
    return off;
}

/**
 * @brief 从 .app 包里提取 main.py 源码
 *  约定 .app 是 zip 包, 但简化实现里 .app 直接是 main.py 文本
 *  第一个文件/段 = manifest JSON (从 #!manifest 注释开始)
 *  然后是空行, 然后是 .py 源码
 */
char *app_loader_read_source(const char *path)
{
    if (!path) return NULL;
    FILE *f = fopen(path, "r");
    if (!f) {
        ESP_LOGW(TAG, "open %s fail", path);
        return NULL;
    }
    fseek(f, 0, SEEK_END);
    long sz = ftell(f);
    fseek(f, 0, SEEK_SET);
    if (sz <= 0 || sz > 32768) {
        fclose(f);
        return NULL;
    }
    char *buf = heap_caps_malloc(sz + 1, MALLOC_CAP_SPIRAM);
    if (!buf) { fclose(f); return NULL; }
    fread(buf, 1, sz, f);
    buf[sz] = 0;
    fclose(f);

    // 找第一个空行作为 manifest/code 分隔符
    char *p = strchr(buf, '\n');
    if (!p) { free(buf); return NULL; }
    if (p[1] != '\n') {
        // 单文件就是源码, 不强求分割
        return buf;
    }
    char *src = heap_caps_malloc(sz + 1, MALLOC_CAP_SPIRAM);
    if (!src) { free(buf); return NULL; }
    strcpy(src, p + 2);   // 跳过 manifest + 空行
    free(buf);
    return src;
}

/**
 * @brief 扫描 /sdcard/roms/*.app 并挂载为 app_info_t
 *  这里只 log 找到的文件, 由 main.c 决定是否注册进 app_manager
 */
int app_loader_scan_app_dir_with_cb(int (*cb)(const app_info_t *))
{
    if (!sdcard_is_mounted()) {
        ESP_LOGW(TAG, "SD not mounted, skip scan");
        return 0;
    }
    const char *dir = "/sdcard/roms";
    mkdir(dir, 0755);

    DIR *d = opendir(dir);
    if (!d) return 0;
    int n = 0;
    struct dirent *de;
    while ((de = readdir(d))) {
        const char *dot = strrchr(de->d_name, '.');
        if (dot && strcmp(dot, ".app") == 0) {
            char path[160];
            snprintf(path, sizeof(path), "%s/%s", dir, de->d_name);
            app_info_t info = {0};
            if (app_loader_load_file(path, &info) == 0) {
                info.source_path = strdup(path);
                if (cb) cb(&info);
                free((void *)info.id);
                free((void *)info.name);
                free((void *)info.glyph);
                free((void *)info.version);
                free((void *)info.source_path);
                n++;
            }
        }
    }
    closedir(d);
    return n;
}